#include <Wire.h>
#include <SD.h>
#include <cmath>

//Definitions
enum {
  MOTOR_PIN = 13,
  
  SECOND_MS = 1000,
  MINUTE_SEC = 60,
  MINUTE_MS = MINUTE_SEC * SECOND_MS,
  
  FIRST_BUZZ_MS = 100,
  FIRST_BUZZ_PAUSE_MS = 50,
  SECOND_BUZZ_MS = 50,
};

typedef enum {
  BUZZ_STAGE_FIRST_BUZZ, 
  BUZZ_STAGE_FIRST_PAUSE, 
  BUZZ_STAGE_SECOND_BUZZ, 
  BUZZ_OFF
} buzz_state_t;

long time_offset = 0;
buzz_state_t buzz_state;
long buzz_last_updated = 0;

const int timestamps[] = {0,790,1604,2459,3339,4250,5144,6035,6909,
7751,8573,9372,10162,10958,11795,12623,13470,14291,15079,15851,16620,
17407,18242,19079,19936,20772,21635,22484,23293,24056,24803,25545,26331,
27178,28062,28944,29809,30657,31464,32284,33100,33848,34546,35199,35845,
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272197,272731,273257,273777,274291,274804,275317,275825,276334,278358};


const unsigned int timestamp_count = sizeof(timestamps) / sizeof(timestamps[0]);
const int last_timestamp = timestamps[timestamp_count - 1];
unsigned int timestamp_index = 0;

long time_since_start(void){
  const long now = millis();
  return (now - time_offset) % last_timestamp;
}

void setup() {
  Serial.begin(9600);
  while(!Serial);
  pinMode(MOTOR_PIN, OUTPUT);
  Serial.println("last_timestamp: " + String("last_timestamp"));
  
  const long now = millis();
  time_offset = now;
}

void execute_buzz(const long time){
  const long time_since_last_buzz = time < buzz_last_updated ? 
                                    ((time + last_timestamp) - buzz_last_updated) :
                                    time - buzz_last_updated;
  switch(buzz_state) {
    case BUZZ_STAGE_FIRST_BUZZ:
      if (time_since_last_buzz > FIRST_BUZZ_MS) {
        digitalWrite(MOTOR_PIN, LOW);
        buzz_last_updated = time;
        buzz_state = BUZZ_STAGE_FIRST_PAUSE;
      }       
      break;
    case BUZZ_STAGE_FIRST_PAUSE:
      if (time_since_last_buzz > FIRST_BUZZ_PAUSE_MS) {
        digitalWrite(MOTOR_PIN, HIGH);
        buzz_last_updated = time;
        buzz_state = BUZZ_STAGE_SECOND_BUZZ;
      }
      break;
    case BUZZ_STAGE_SECOND_BUZZ:
      if (time_since_last_buzz > SECOND_BUZZ_MS) {
        digitalWrite(MOTOR_PIN, LOW);
        buzz_last_updated = time;
        buzz_state = BUZZ_OFF;
      }       
      break;
    case BUZZ_OFF:
      break;
    default:
      break;
  }
}

void loop() {
  // Get current time within looping window
  const long time = time_since_start();
  // Update buzzing as needed
  execute_buzz(time);
  // Check if we've passed the next timestamp or not
  if (time < timestamps[timestamp_index]) {
    return;
  }
  const int seconds = (time / SECOND_MS) % MINUTE_SEC;
  const int minutes = time / MINUTE_MS;
  Serial.printf("%02d:%02d\n", minutes, seconds);
  
  // Time for next beat in list
  timestamp_index = (timestamp_index + 1) % timestamp_count;
  // Kick off first phase of buzz
  buzz_state = BUZZ_STAGE_FIRST_BUZZ;
  buzz_last_updated = time;
  digitalWrite(MOTOR_PIN, HIGH);
}
 
